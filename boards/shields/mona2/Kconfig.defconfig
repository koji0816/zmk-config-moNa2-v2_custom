## boards/shields/mona2/Kconfig.defconfig
```kconfig
if SHIELD_MONA2_R
config ZMK_KEYBOARD_NAME
    default "mona2"
config ZMK_BLE
    default y
config ZMK_SPLIT_ROLE_CENTRAL
    default y
config INPUT
    default y
config ZMK_POINTING
    default y
config SPI
    default y
config PMW3610
    bool
    default y
endif

if SHIELD_MONA2_R || SHIELD_MONA2_L
config NFCT_PINS_AS_GPIOS
    default y
config ZMK_SPLIT
    default y
config RGBLED_WIDGET_BATTERY_LEVEL_HIGH
    default 30
config RGBLED_WIDGET_BATTERY_LEVEL_CRITICAL
    default 10
endif

if SHIELD_MONA2_DONGLE
config ZMK_KEYBOARD_NAME
    default "moNa2"

config ZMK_SPLIT
    default y

config ZMK_SPLIT_ROLE_CENTRAL
    default y

config ZMK_BLE
    default y

config ZMK_SPLIT_BLE_CENTRAL_PERIPHERALS
    default 2

config BT_MAX_CONN
    default 7

config BT_MAX_PAIRED
    default 7
endif # SHIELD_MONA2_DONGLE
```

## config/west.yml
```yaml
manifest:
  remotes:
    - name: zmkfirmware
      url-base: https://github.com/zmkfirmware
    - name: sayu-hub
      url-base: https://github.com/sayu-hub
    - name: badjeff
      url-base: https://github.com/badjeff
    - name: caksoylar
      url-base: https://github.com/caksoylar  
    - name: zettaface
      url-base: https://github.com/zettaface      
    - name: TakeshiAkehi
      url-base: https://github.com/TakeshiAkehi
  projects:
    - name: zmk
      remote: zmkfirmware
      revision: main      # <--- v0.3.0 から変更
      import: app/west.yml
    - name: zmk-pmw3610-driver
      remote: badjeff
      revision: main      # <--- zmk-0.3 から変更
    - name: zmk-rgbled-widget
      remote: caksoylar
      revision: main      # <--- v0.3-branch から変更
    - name: zmk-input-processor-keybind
      remote: zettaface
      revision: main
#    - name: zmk-module-xiaord
#      remote: TakeshiAkehi
#      revision: main
    - name: zmk-module-xiaord
      url: https://github.com/koji0816/zmk-module-xiaord-cust.git # ご自身のカスタムリポジトリURLに変更
      revision: no-central # 読み込むブランチ名を指定
  self:
    path: config
```
